## tools/aarch64_qemu_virt.its
```
/dts-v1/;

/ {
    description = "U-Boot FIT Image";
    #address-cells = <1>;

    images {
        kernel@1 {
            description = "Linux Kernel";
			// 内核路径
            data = /incbin/("./zImage");
            type = "kernel";
			// 架构类型
            arch = "arm64";
            os = "linux";
			// 压缩方式
            compression = "none";
			// 内核加载地址
            load = <0x80008000>;
			// 内核入口地址
            entry = <0x80008000>;
            hash-1 {
                algo = "sha1";
            };
        };

        fdt@1 {
            description = "Device Tree Blob";
			// dtb 路径
            data = /incbin/("./myboard.dtb");
            type = "flat_dt";
            arch = "arm64";
            compression = "none";
            hash-1 {
                algo = "sha1";
            };
        };

        ramdisk@1 {
            description = "Root Filesystem";
			// 根文件系统路径
            data = /incbin/("./rootfs.cpio.gz");
            type = "ramdisk";
            arch = "arm64";
            os = "linux";
            compression = "none";
            hash-1 {
                algo = "sha1";
            };
        };
    };

    configurations {
        default = "config@1";

        config@1 {
            description = "Default Boot Configuration";
            kernel = "kernel@1";
            fdt = "fdt@1";
            ramdisk = "ramdisk@1";
            hash-1 {
                algo = "sha1";
            };
        };
    };
};
```
